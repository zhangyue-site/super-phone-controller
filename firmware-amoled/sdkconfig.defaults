## firmware-epaper/main/Kconfig.projbuild
```kconfig
menu "Controller experimental transport"
config CONTROLLER_USB_LOCAL
    bool "USB local-only DHCP maintenance profile"
    depends on TINYUSB_NET_MODE_NCM
    default n
    help
        Isolated test: board 192.168.77.1 leases an address to the phone.
        No internet gateway/DNS advertised. Does not enable ADB automatically.
config CONTROLLER_USB_MAINTENANCE
    bool "Private USB diagnostic commands (maintenance only)"
    default n
    help
        Explicitly enables diagnostic CDC commands. Keep disabled in normal
        builds; enabling this does not authorize a target device or task.
config CONTROLLER_ADB_MAINTENANCE
    bool "Legacy ADB transport for explicit maintenance builds only"
    depends on CONTROLLER_USB_LOCAL
    default n
    help
        Disabled for daily use. Enabling restores the historical phone5555
        authentication/proxy and ADB Keyboard diagnostic path. Pure USB HID,
        CDC and NCM do not require this option. Never enable in production.
config CONTROLLER_EXTERNAL_KEYS
    bool "V2 external dry-contact keys on J1 GPIO1/GPIO2"
    default n
    help
        Two normally-open, voltage-free contacts. A: GPIO1 to GND.
        B: GPIO2 to GND. Internal pull-ups; no external supply required.
        Uses only the V2 board's otherwise-unused J1 pins. External B never
        powers off the board. Leave disabled when these pins serve other hardware.
endmenu
```

## firmware-epaper/sdkconfig.defaults
```kconfig
CONFIG_IDF_TARGET="esp32s3"
CONFIG_ESPTOOLPY_FLASHSIZE_8MB=y
CONFIG_SPIRAM=y
CONFIG_SPIRAM_MODE_OCT=y
CONFIG_SPIRAM_SPEED_80M=y
CONFIG_SPIRAM_USE_MALLOC=y
CONFIG_PARTITION_TABLE_CUSTOM=y
CONFIG_PARTITION_TABLE_CUSTOM_FILENAME="partitions.csv"
CONFIG_ESP_CONSOLE_UART_DEFAULT=y
CONFIG_TINYUSB_HID_COUNT=1
CONFIG_TINYUSB_CDC_ENABLED=y
CONFIG_TINYUSB_CDC_COUNT=1
CONFIG_MBEDTLS_CERTIFICATE_BUNDLE=y
CONFIG_ESP_MAIN_TASK_STACK_SIZE=8192
```
